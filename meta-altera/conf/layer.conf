## meta-altera/conf/layer.conf
```bitbake
# We have a conf and classes directory, add to BBPATH
BBPATH := "${LAYERDIR}:${BBPATH}"

# We have a packages directory, add to BBFILES
BBFILES := "${BBFILES} ${LAYERDIR}/recipes-*/*/*.bb \
	${LAYERDIR}/recipes-*/*/*.bbappend"

BBFILE_COLLECTIONS += "socfpga_cyclone5"
BBFILE_PATTERN_socfpga_cyclone5 = "^${LAYERDIR}/"
BBFILE_PRIORITY_socfpga_cyclone5 = "6"
```

## meta-altera/conf/machine/socfpga5xs1.conf
```bitbake
#@TYPE: Machine
#@NAME: socfpga
#@DESCRIPTION: Machine configuration for Altera socfpga5xs1 based systems

MACHINE_FEATURES = "serial"

require conf/machine/include/tune-cortexa9.inc

UBOOT_MACHINE = "vtdev5xs1_config"
UBOOT_ENTRYPOINT = "0x00008000"

KERNEL_IMAGETYPE = "uImage"
SERIAL_CONSOLE = "57600 ttyS0"

IMAGE_FSTYPES ?= "cpio ext2 tar.gz"

ROOT_FLASH_SIZE = "16"

PREFERRED_PROVIDER_virtual/bootloader ?= "u-boot-altera"
PREFERRED_PROVIDER_virtual/kernel ?= "linux-altera"
```

## meta-altera/conf/machine/socfpga_cyclone5.conf
```bitbake
#@TYPE: Machine
#@NAME: socfpga
#@DESCRIPTION: Machine configuration for Altera socfpga5xs1 based systems

MACHINE_FEATURES = "serial rtc"
DISTRO_FEATURES = " ${DISTRO_FEATURES_LIBC}"
MACHINE_DEFCONFIG = "socfpga_defconfig"

require conf/machine/include/tune-cortexa9.inc

UBOOT_MACHINE = "socfpga_cyclone5_config"
UBOOT_ENTRYPOINT = "0x00008000"

KMACHINE = "socfpga_cyclone5"
KERNEL_IMAGETYPE = "zImage"
SERIAL_CONSOLE = "57600 ttyS0"

IMAGE_FSTYPES ?= "cpio ext3 tar.gz jffs2"

EXTRA_IMAGECMD_jffs2 ?= "--pad --little-endian --eraseblock=0x10000 --pagesize=0x100"
ROOT_FLASH_SIZE = "16"

PREFERRED_PROVIDER_virtual/bootloader ?= "u-boot-altera"
PREFERRED_PROVIDER_u-boot ?= "u-boot-altera"
PREFERRED_PROVIDER_virtual/kernel ?= "linux-altera"
PREFERRED_PROVIDER_linux ?= "linux-altera"
PREFERRED_PROVIDER_u-boot-mkimage ?= "u-boot-mkimage-altera"
PREFERRED_PROVIDER_linux-libc-headers ?= "linux-libc-headers-altera"
PREFERRED_PROVIDER_linux-libc-headers-dev ?= "linux-libc-headers-altera"

PREFERRED_VERSION_linux-altera ?= "3.8"
PREFERRED_VERSION_linux-libc-headers-altera ?= "3.8"
PREFERRED_VERSION_u-boot-altera ?= "2013.01.01"
PREFERRED_VERSION_u-boot-mkimage-altera ?= "2013.01.01"
```

## meta-altera/conf/machine/socfpga_vt.conf
```bitbake
#@TYPE: Machine
#@NAME: socfpga
#@DESCRIPTION: Machine configuration for Altera socfpga5xs1 based systems

MACHINE_FEATURES = "serial"
DISTRO_FEATURES = " ${DISTRO_FEATURES_LIBC}"
MACHINE_DEFCONFIG = "socfpga_defconfig"

require conf/machine/include/tune-cortexa9.inc

UBOOT_MACHINE = "socfpga_vtdev5xs1"
UBOOT_ENTRYPOINT = "0x00008000"

KERNEL_DEVICETREE = "${S}/arch/${ARCH}/boot/dts/socfpga_vt.dts"
KMACHINE = "socfpga_cyclone5"
KERNEL_IMAGETYPE = "uImage"
SERIAL_CONSOLE = "57600 ttyS0"

IMAGE_FSTYPES ?= "cpio ext2 tar.gz jffs2"

ROOT_FLASH_SIZE = "16"

PREFERRED_PROVIDER_virtual/bootloader ?= "u-boot-altera"
PREFERRED_PROVIDER_virtual/kernel ?= "linux-altera"

LINUXLIBCVERSION ?= "altera-3.6"
PREFERRED_VERSION_linux ?= "altera-3.6"
PREFERRED_VERSION_linux-libc-headers ?= "altera-3.6"
PREFERRED_VERSION_u-boot ?= "altera-2012.10"
PREFERRED_VERSION_u-boot-mkimage ?= "altera-2012.10"
```

## meta-iptronix/conf/machine/socfpga_cyclone5.conf
```bitbake
#@TYPE: Machine
#@NAME: socfpga
#@DESCRIPTION: Machine configuration for Altera socfpga5xs1 based systems

MACHINE_FEATURES = "serial rtc screen"
DISTRO_FEATURES = " ${DISTRO_FEATURES_LIBC} x11"
MACHINE_DEFCONFIG = "socfpga_defconfig"

require conf/machine/include/tune-cortexa9.inc
DEFAULTTUNE = "cortexa9hf-neon"

UBOOT_MACHINE = "socfpga_cyclone5_config"
UBOOT_ENTRYPOINT = "0x00008000"

KMACHINE = "socfpga_cyclone5"
KERNEL_IMAGETYPE = "zImage"
SERIAL_CONSOLE = "115200 ttyS0"

IMAGE_FSTYPES ?= "cpio ext3 tar.gz jffs2"

EXTRA_IMAGECMD_jffs2 ?= "--pad --little-endian --eraseblock=0x10000 --pagesize=0x100"
ROOT_FLASH_SIZE = "16"
```

## meta-linaro/conf/distro/include/tclibc-external-linaro-toolchain.inc
```bitbake
#
# eglibc specific configuration
#

LIBCEXTENSION = "${@['', '-gnu'][(d.getVar('ABIEXTENSION', True) or '') != '']}"

# Add glibc overrides to the overrides for eglibc.
LIBCOVERRIDE = ":libc-glibc"
OVERRIDES .= "${LIBCOVERRIDE}"

PREFERRED_PROVIDER_virtual/libiconv ?= "external-linaro-toolchain"
PREFERRED_PROVIDER_virtual/nativesdk-libiconv ?= "external-linaro-toolchain"
PREFERRED_PROVIDER_virtual/nativesdk-libintl ?= "external-linaro-toolchain"
PREFERRED_PROVIDER_virtual/libintl ?= "external-linaro-toolchain"
PREFERRED_PROVIDER_virtual/libc ?= "external-linaro-toolchain"
PREFERRED_PROVIDER_virtual/nativesdk-libc ?= "external-linaro-toolchain"
PREFERRED_PROVIDER_virtual/libc-locale ?= "external-linaro-toolchain"

#CXXFLAGS += "-fvisibility-inlines-hidden"

LIBC_DEPENDENCIES = "external-linaro-toolchain"
#libsegfault \
		     eglibc \
		     eglibc-dbg \
		     eglibc-dev \
		     eglibc-utils \
		     eglibc-thread-db \
		     ${@get_libc_locales_dependencies(d)}"

LIBC_LOCALE_DEPENDENCIES = ""
#\
	eglibc-localedata-i18n \
	eglibc-gconv-ibm850 \
	eglibc-gconv-cp1252 \
	eglibc-gconv-iso8859-1 \
	eglibc-gconv-iso8859-15"

def get_libc_locales_dependencies(d):
    if 'libc-locales' in (d.getVar('DISTRO_FEATURES', True) or '').split() :
        return d.getVar('LIBC_LOCALE_DEPENDENCIES', True) or ''
    else:
        return ''
```

## meta-linaro/conf/distro/include/tcmode-external-linaro.inc
```bitbake
#
# Configuration to use an external Linaro binary toolchain
#

EXTERNAL_TOOLCHAIN ?= "/usr/local/linaro-binary-toolchain/${TARGET_ARCH}"

TOOLCHAIN_PATH_ADD = "${EXTERNAL_TOOLCHAIN}/bin:"
PATH =. "${TOOLCHAIN_PATH_ADD}"

ELT_TARGET_SYS = "arm-linux-gnueabihf"
TARGET_PREFIX = "${ELT_TARGET_SYS}-"

PREFERRED_PROVIDER_linux-libc-headers = "external-linaro-toolchain"
PREFERRED_PROVIDER_linux-libc-headers-dev = "external-linaro-toolchain"
PREFERRED_PROVIDER_virtual/${TARGET_PREFIX}gcc = "external-linaro-toolchain"
PREFERRED_PROVIDER_virtual/${TARGET_PREFIX}gcc-initial = "external-linaro-toolchain"
PREFERRED_PROVIDER_virtual/${TARGET_PREFIX}g++ = "external-linaro-toolchain"
PREFERRED_PROVIDER_virtual/${TARGET_PREFIX}binutils = "external-linaro-toolchain"
PREFERRED_PROVIDER_virtual/${TARGET_PREFIX}libc-for-gcc = "external-linaro-toolchain"
PREFERRED_PROVIDER_virtual/${TARGET_PREFIX}libc-initial = "external-linaro-toolchain"
PREFERRED_PROVIDER_virtual/${TARGET_PREFIX}compilerlibs = "external-linaro-toolchain"
PREFERRED_PROVIDER_libgcc = "external-linaro-toolchain"
PREFERRED_PROVIDER_virtual/libc = "external-linaro-toolchain"
PREFERRED_PROVIDER_virtual/libintl = "external-linaro-toolchain"
PREFERRED_PROVIDER_virtual/libiconv = "external-linaro-toolchain"
PREFERRED_PROVIDER_glibc-thread-db = "external-linaro-toolchain"
PREFERRED_PROVIDER_virtual/linux-libc-headers = "external-linaro-toolchain"
PREFERRED_PROVIDER_virtual/${BUILD_ARCH}-pokysdk-linux-gcc-crosssdk = "external-linaro-toolchain"
PREFERRED_PROVIDER_virtual/nativesdk-${BUILD_ARCH}-pokysdk-linux-libc-for-gcc = "external-linaro-toolchain"
PREFERRED_PROVIDER_virtual/nativesdk-libintl = "nativesdk-gettext"

TARGET_CPPFLAGS_prepend = " -isystem${EXTERNAL_TOOLCHAIN}/${ELT_TARGET_SYS}/include "
TARGET_LDFLAGS_prepend = " -L${EXTERNAL_TOOLCHAIN}/${ELT_TARGET_SYS}/lib -Wl,-rpath-link,${EXTERNAL_TOOLCHAIN}/${ELT_TARGET_SYS}/lib "

TOOLCHAIN_OPTIONS = " --sysroot=${STAGING_DIR_HOST}"

DISTRO_FEATURES_LIBC = "ipv4 ipv6 libc-backtrace libc-big-macros libc-bsd libc-cxx-tests libc-catgets libc-crypt \
			libc-crypt-ufc libc-db-aliases libc-envz libc-fcvt libc-fmtmsg libc-fstab libc-ftraverse \
			libc-getlogin libc-idn libc-inet-anl libc-libm libc-libm-big \
			libc-memusage libc-nis libc-nsswitch libc-rcmd libc-rtld-debug libc-spawn libc-streams libc-sunrpc \
			libc-utmp libc-utmpx libc-wordexp libc-posix-clang-wchar libc-posix-regexp libc-posix-regexp-glibc \
			libc-posix-wchar-io"

ENABLE_BINARY_LOCALE_GENERATION = "0"
GLIBC_INTERNAL_USE_BINARY_LOCALE = "precompiled"

def populate_toolchain_links(d):
    import errno
    import os
    from glob import glob

    d = d.createCopy()
    d.finalize()

    pattern = bb.data.expand('${EXTERNAL_TOOLCHAIN}/bin/${TARGET_PREFIX}*', d)
    files = glob(pattern)
    if not files:
        bb.fatal("Unable to populate toolchain binary symlinks")

    bindir = d.getVar('STAGING_BINDIR_TOOLCHAIN', True)
    bb.mkdirhier(bindir)
    for f in files:
        base = os.path.basename(f)
        newpath = os.path.join(bindir, base)
        try:
            os.symlink(f, newpath)
        except OSError as exc:
            if exc.errno == errno.EEXIST:
                break
            bb.fatal("Unable to populate toolchain binary symlink for %s: %s" % (newpath, exc))

require conf/distro/include/external-linaro-toolchain-versions.inc
```

## meta-linaro/conf/layer.conf
```bitbake
BBPATH .= ":${LAYERDIR}"
BBFILES += "\
            ${LAYERDIR}/recipes-*/*/*.bb \
            ${LAYERDIR}/recipes-*/*/*.bbappend \
           "

BBFILE_COLLECTIONS += "linaro"
BBFILE_PATTERN_linaro := "^${LAYERDIR}/"
BBFILE_PRIORITY_linaro = "5"

# do not error out on bbappends for missing recipes (mysql5)
BB_DANGLINGAPPENDS_WARNONLY = "true"

#LAYERDEPENDS_linaro = "toolchain-layer"
```

## meta-linaro/conf/machine/genericarmv7a.conf
```bitbake
#@TYPE: Machine
#@NAME: generic armv7a machine
#@DESCRIPTION: generic machine to be used by linaro-media-create

require conf/machine/include/arm/arch-armv7a.inc

PREFERRED_PROVIDER_virtual/xserver ?= "xserver-xorg"

XSERVER ?= "xserver-xorg \
            mesa-dri-driver-swrast \
            xf86-input-evdev \
            xf86-input-mouse \
            xf86-video-fbdev \
            xf86-input-keyboard"

MACHINE_FEATURES = "usbhost screen"

# Don't include kernels in standard images
RDEPENDS_kernel-base = ""

# Use a common kernel recipe for all QEMU machines
PREFERRED_PROVIDER_virtual/kernel ?= "linux-yocto"

KERNEL_IMAGETYPE = "zImage"

# Force auto-serial-console to be used by all image types
# Ideally this would be part of core oe or as a bbclassappend,
# but as we don't have an easy way to append a class, defining
# it here
EXTRA_IMAGE_FEATURES += "autoserial"
PACKAGE_GROUP_autoserial = "auto-serial-console"
```

## meta-linaro/conf/machine/qemuarmv7a.conf
```bitbake
#@TYPE: Machine
#@NAME: arm_vexpress
#@DESCRIPTION: arm_vexpress

require conf/machine/include/qemu.inc
require conf/machine/include/arm/arch-armv7a.inc

KERNEL_IMAGETYPE = "zImage"

SERIAL_CONSOLE = "38400n8 ttyAMA0"
```
